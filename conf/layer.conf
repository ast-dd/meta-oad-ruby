## conf/layer.conf
```bitbake
# We have a conf and classes directory, append to BBPATH 
BBPATH .= ":${LAYERDIR}"

# We have a recipes directory, add to BBFILES
BBFILES += "${LAYERDIR}/recipes-*/*/*.bb ${LAYERDIR}/recipes-*/*/*.bbappend"

BBFILE_COLLECTIONS += "oad-ruby-layer"
BBFILE_PATTERN_oad-ruby-layer := "^${LAYERDIR}/"
BBFILE_PRIORITY_oad-ruby-layer = "7"

# This should only be incremented on significant changes that will
# cause compatibility issues with other layers
LAYERVERSION_oad-ruby-layer = "1"

LAYERDEPENDS_oad-ruby-layer = "core openembedded-layer"
```
